## firmware/amp.its
```
/* SPDX-License-Identifier: BSD-3-Clause */
/*
 * Copyright (c) 2026 shu-sdk contributors
 *
 * AMP FIT for the shu-sdk boards.  Combines the two firmware images u-boot
 * releases when CONFIG_ROCKCHIP_AMP is set:
 *
 *   amp2   type=firmware   RT-Thread on the 3rd Cortex-A7 (cpu@f02), loaded
 *                          at 0x03e00000 and started via PSCI smc_cpu_on
 *   mcu    type=standalone bare-metal rpmsg responder on the Cortex-M0,
 *                          loaded at 0xfff84000 and released by the TEE
 *
 * The firmware stage (stages/40-firmware/run.sh) stages the built binaries
 * next to this ITS as amp2.bin / mcu.bin and runs:
 *   mkimage -f amp.its -E -p 0xe00 amp.img
 *
 * See doc/amp.md.
 */

/dts-v1/;
/ {
	description = "Rockchip AMP FIT Image";
	#address-cells = <1>;

	images {
		amp2 {
			description  = "rtos-core2";
			data         = /incbin/("amp2.bin");
			type         = "firmware";
			compression  = "none";
			arch         = "arm";	 // "arm64" or "arm"
			cpu          = <0xf02>;  // mpidr
			thumb        = <0>;      // 0: arm or thumb2; 1: thumb
			hyp          = <0>;      // 0: el1/svc; 1: el2/hyp
			load         = <0x03e00000>;
			size         = <0x00100000>;
			srambase     = <0xfff80000>;
			sramsize     = <0x0000c000>;
			udelay       = <10000>;
			hash {
				algo = "sha256";
			};
		};

		mcu {
			description  = "mcu-rpmsg-responder";
			data         = /incbin/("mcu.bin");
			type         = "standalone";	// must be "standalone"
			compression  = "none";
			arch         = "arm";		// "arm64" or "arm", the same as U-Boot state
			load         = <0xfff84000>;
			udelay       = <1000000>;
			hash {
				algo = "sha256";
			};
		};
	};

	configurations {
		default = "conf";
		conf {
			description = "Rockchip AMP images";
			rollback-index = <0x0>;
			loadables = "amp2", "mcu";

			signature {
				algo = "sha256,rsa2048";
				padding = "pss";
				key-name-hint = "dev";
				sign-images = "loadables";
			};
		};
	};
};
```

## product/platform/configs/buildroot/luckfox_pico_ubifs_defconfig
```kconfig
# Luckfox Pico (RV1106/RV1103) — 精简核心, SPI NAND rootfs (ubifs)
#
# 与 luckfox_pico_ext4_defconfig 同源(官方 luckfox_pico_defconfig 精简),
# 差异:不带 e2fsprogs,改带 mtd 工具(flash_eraseall/ubiformat 等,spi_nand
# 板上的常用 NAND 管理工具)。 rootfs.img 由 30-rootfs stage 用
# mkfs.ubifs + ubinize 按官方配方生成(128KiB block / 2KiB page / lzo)。
BR2_arm=y
BR2_cortex_a7=y
BR2_TOOLCHAIN_EXTERNAL=y
BR2_TOOLCHAIN_EXTERNAL_CUSTOM=y
BR2_TOOLCHAIN_EXTERNAL_CUSTOM_UCLIBC=y
BR2_TOOLCHAIN_EXTERNAL_PATH="/opt/toolchains/arm-rockchip830-linux-uclibcgnueabihf"
BR2_TOOLCHAIN_EXTERNAL_CUSTOM_PREFIX="arm-rockchip830-linux-uclibcgnueabihf"
BR2_TOOLCHAIN_EXTERNAL_GCC_8=y
BR2_TOOLCHAIN_EXTERNAL_HEADERS_5_10=y
BR2_TOOLCHAIN_EXTERNAL_WCHAR=y
BR2_TOOLCHAIN_EXTERNAL_HAS_SSP=y
BR2_TOOLCHAIN_EXTERNAL_CXX=y
BR2_PRIMARY_SITE="http://sources.buildroot.net"
BR2_OPTIMIZE_3=y
BR2_TARGET_GENERIC_HOSTNAME="luckfox-pico"
BR2_TARGET_GENERIC_ISSUE="Welcome to luckfox pico"
BR2_TARGET_GENERIC_ROOT_PASSWD="luckfox"
BR2_SYSTEM_ENABLE_NLS=y
BR2_PACKAGE_BUSYBOX_SHOW_OTHERS=y
BR2_PACKAGE_PYTHON3=y
BR2_PACKAGE_PYTHON3_SSL=y
BR2_PACKAGE_IPERF3=y
BR2_PACKAGE_LRZSZ=y
BR2_PACKAGE_OPENSSH=y
BR2_PACKAGE_NANO=y
BR2_PACKAGE_HTOP=y
BR2_PACKAGE_MTD=y
BR2_ROOTFS_POST_BUILD_SCRIPT="board/luckfox/common/post-build.sh"
```
